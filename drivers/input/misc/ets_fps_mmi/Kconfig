## drivers/input/misc/ets_fps_mmi/Kconfig
```kconfig
config INPUT_ETS_FPS_MMI
	bool "Fingerprint EGIS device"
	default n

config INPUT_EGISTEC_FPS_NAVI
	bool "EGIS fingerprint navigation"
	depends on INPUT_ETS_FPS_MMI
	default y

config INPUT_EGISTEC_FPS_NAVI_HORIZON
	bool "EGIS fingerprint horizontal navigation"
	depends on INPUT_EGISTEC_FPS_NAVI
	default y

config INPUT_EGISTEC_FPS_NAVI_VERTICAL
	bool "EGIS fingerprint vertical navigation"
	depends on INPUT_EGISTEC_FPS_NAVI
	default y

config DISPLAY_SPEED_UP
	bool "EGIS fingerprint display speed up"
	depends on INPUT_ETS_FPS_MMI
	default n
```

## drivers/input/misc/fpc_fps_mmi/Kconfig
```kconfig
config INPUT_FPC1020_PLATFORM
	bool "Fingerprint FPC1020 device"
	default n

config INPUT_MISC_FPC1020_SAVE_TO_CLASS_DEVICE
	bool "FPC1020 SAVE TO CLASS DEVICE"
	depends on INPUT_FPC1020_PLATFORM
	default y
```

## drivers/misc/awinic/aw8695/Kconfig
```kconfig
config INPUT_AWINIC_AW8695_HAPTIC
	tristate "Awinic AW8695 haptic driver"
	depends on I2C
	default n
```

## drivers/misc/tps61280/Kconfig
```kconfig
config TI_TPS61280
	bool "Driver for TI,TP61280 DC/DC Boost Converter"
	default n
```
